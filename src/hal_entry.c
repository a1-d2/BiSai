#include "hal_data.h"
#include "Motor_Control.h"
#include "DHT11.h"
#include "Chao_Sheng_Bo.h"
#include <stdio.h>
#include <string.h>
#include "Duo_Ji.h"
#include "ADC.h"
#include "r_adc_api.h"
#include "UART.h"

bsp_io_level_t Hong_Wai_Pin;//红外状态存放引脚，0为有遮挡，1为没有遮挡

#define Hong_Wai_Du_Qu() R_IOPORT_PinRead(&g_ioport_ctrl, BSP_IO_PORT_07_PIN_08, &Hong_Wai_Pin);//读取红外状态

#if (1 == BSP_MULTICORE_PROJECT) && BSP_TZ_SECURE_BUILD
bsp_ipc_semaphore_handle_t g_core_start_semaphore =
{
    .semaphore_num = 0
};
#endif

/*******************************************************************************************************************//**
 * main() is generated by the RA Configuration editor and is used to generate threads if an RTOS is used.  This function
 * is called by main() when no RTOS is used.
 **********************************************************************************************************************/

/***************************************全局变量***********************************************/

const int8_t ADC_Open_err[] = "ADC_Open_err";
const uint8_t ADC_Pei_Zhi_err[] = "ADC_Pei_Zhi_err";
uint8_t uart_buf[50] = {0}; // 串口发送代码的存放字符串的数组

/*********************************************************************************************/

void hal_entry(void)
{
	R_IOPORT_Open(&g_ioport_ctrl, g_ioport.p_cfg);//初始化配置引脚，加载瑞萨 RA 配置工具（FSP Configurator）里配置的所有引脚模式
	
/******************************设置变量******************************************************/
	
	float Ju_Li = 0;  			             // 每次超声波采集的距离
	float Sum = 0;   			            // 5次超声波采集距离的总和
	float Mean = 0; 			           // 取平均数使结果更准确
	uint8_t k = 0;             			  // 超声波测距次数计数变量
	uint16_t forward_count = 0;          // 计次变量
    const uint16_t forward_total = 100; // 总前进时长100×10ms=1秒
	fsp_err_t err = FSP_SUCCESS;       // 错误判断的变量
	extern float adc_voltage[8];     // 转换后的电压值
	
/**************************** 初始化部分 *******************************************/

	Motor_PWM_Init();			 // 电机初始化
	UART0_Init();   			// 串口初始化
	Chao_Sheng_Bo_GPT0_Init(); // 超声波初始化
	Duo_Ji_Init();			  // 舵机初始化
	
	err = R_ADC_Open(&g_adc0_ctrl,&g_adc0_cfg); // 初始化ADC0
	if(FSP_SUCCESS != err) // 异常时输出错误信息
	{
		R_SCI_UART_Write(&g_uart0_ctrl,ADC_Open_err,sizeof(ADC_Open_err)-1);
		return;
	}		
	
	err = R_ADC_ScanCfg(&g_adc0_ctrl,&g_adc0_channel_cfg); // 配置ADC0通道
	if(FSP_SUCCESS != err) // 异常时输出错误信息
	{
		R_SCI_UART_Write(&g_uart0_ctrl,ADC_Pei_Zhi_err,sizeof(ADC_Pei_Zhi_err)-1);
		return;
	}
	
/**********************************************************************************/
	
	//DHT11_Read(); // 读取DHT11温湿度数据并校验
	
	Motor_Left_Speed(75);   // 设置左电机速度
	Motor_Right_Speed(75); // 设置右电机速度

	while(1)
	{
		
//		adc_scan_start(); // 启动ADC扫描并读取8路数据
//		for(uint8_t i = 0;i < 8; i++)
//		{
//			sprintf((char *)uart_buf, "D%d = %.4fV\n",i+1 ,adc_voltage[i]);
//			uint16_t send_len = (uint16_t)strlen((char *)uart_buf);
//			R_SCI_UART_Write(&g_uart0_ctrl,uart_buf,send_len);
//			while(!uart_complete_flag); // 等待串口发送完成
//			uart_complete_flag = false;
//		}
//		R_BSP_SoftwareDelay(2000, BSP_DELAY_UNITS_MILLISECONDS);
//		sprintf((char *)uart_buf, "Channel:%d,VOL:%.4f", , adc0_DianYa0);
//		uint16_t send_len = (uint16_t)strlen((char *)uart_buf);
//		R_SCI_UART_Write(&g_uart0_ctrl,uart_buf,send_len);
//		R_BSP_SoftwareDelay(1000, BSP_DELAY_UNITS_MILLISECONDS);
//		Duo_Ji_PWM(2.5f); // 从后面看，右转
//		R_BSP_SoftwareDelay(2000, BSP_DELAY_UNITS_MILLISECONDS);
//		Duo_Ji_PWM(7.0f); // 从后面看，正前方
//		R_BSP_SoftwareDelay(2000, BSP_DELAY_UNITS_MILLISECONDS);
//		Duo_Ji_PWM(12.5f); // 从后面看，左转
//		R_BSP_SoftwareDelay(2000, BSP_DELAY_UNITS_MILLISECONDS);
//		Hong_Wai_Du_Qu();      // 读取红外传感器的状态
//		if(Hong_Wai_Pin == 1) // 如果没有遮挡则启动电机，1为没有遮挡，0为有遮挡
//		{
//			  Car_Forward();
//            forward_count++;
//            // 前进满1秒后重置计数（避免一直前进）
//            if(forward_count >= forward_total)
//            {
//                forward_count = 0;
//            }
//            R_BSP_SoftwareDelay(10, BSP_DELAY_UNITS_MILLISECONDS);
//		}
//		else
//		{
//			Car_Stop();//小车停止
//			forward_count = 0;
//		}
//		Ju_Li = HC_SR04_Measure(); // 超声波测距采集
//		R_BSP_SoftwareDelay(90, BSP_DELAY_UNITS_MILLISECONDS);
//		// 过滤0值，确保累加有效距离
//		if(Ju_Li > 0) 
//		{
//			Sum += Ju_Li;
//			k++;
//		}
//		if(k == 5)
//		{
//			Mean = Sum / 5;
//			sprintf((char *)uart_buf,"Ju_Li=%.2f",Mean);
//			uint16_t send_len = (uint16_t)strlen((char *)uart_buf);
//			R_SCI_UART_Write(&g_uart0_ctrl,uart_buf,send_len);
//			k = 0;
//			Sum = 0;   // 5次超声波采集距离的总和
//		}
	}

    /* Wake up 2nd core if this is first core and we are inside a multicore project. */
#if (0 == _RA_CORE) && (1 == BSP_MULTICORE_PROJECT) && !BSP_TZ_NONSECURE_BUILD

#if BSP_TZ_SECURE_BUILD
    /* Take semaphore so 2nd core can clear it */
    R_BSP_IpcSemaphoreTake(&g_core_start_semaphore);
#endif

    R_BSP_SecondaryCoreStart();

#if BSP_TZ_SECURE_BUILD
    /* Wait for 2nd core to start and clear semaphore */
    while(FSP_ERR_IN_USE == R_BSP_IpcSemaphoreTake(&g_core_start_semaphore))
    {
        ;
    }
#endif
#endif

#if (1 == _RA_CORE) && (1 == BSP_MULTICORE_PROJECT) && BSP_TZ_SECURE_BUILD
    /* Signal to 1st core that 2nd core has started */
    R_BSP_IpcSemaphoreGive(&g_core_start_semaphore);
#endif


#if BSP_TZ_SECURE_BUILD
    /* Enter non-secure code */
    R_BSP_NonSecureEnter();
#endif
}

#if BSP_TZ_SECURE_BUILD

FSP_CPP_HEADER
BSP_CMSE_NONSECURE_ENTRY void template_nonsecure_callable ();

/* Trustzone Secure Projects require at least one nonsecure callable function in order to build (Remove this if it is not required to build). */
BSP_CMSE_NONSECURE_ENTRY void template_nonsecure_callable ()
{

}
FSP_CPP_FOOTER

#endif

